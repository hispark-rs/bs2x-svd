# BS2X register map
File version: 0.1
HiSilicon BS21 / BS2X BLE 5.4 + SLE/NearLink SoC — ISA: rv32i2p1_m2p0_f2p2_c2p0_zicsr2p0 (RV32IMFC_Zicsr), 64MHz app core, 512KB ITCM, 160KB L2RAM, 1MB XIP flash @0x10000000. Shares WS63's HimiDeer riscv31 core + versioned IP (UART v151/TIMER v150/GPIO v150).
CPU: other r0p0, little endian, MPU, FPU, 3 interrupt priority bits
Registers are 32-bit, read-write, reset 0x0 unless marked. A register's access mark holds for its fields unless they carry their own. Offsets are from the block's base; lines under a group give offsets from that group; [hi:lo] are bit positions; {n}, {i} and the like mark numbered series; 'fields as' and 'values as' point back to an identical list; <NAME> marks a mode.

## Memory map
0x52000200 QDEC size 0x80 — Quadrature decoder (v150)
0x52002000 TIMER size 0x1000 — Timer module with 3 independent 32-bit timers (v150)
0x52003000 WDT size 0x1000 — Watchdog timer (v151)
0x52009000 TRNG size 0x210 — True random number generator (v1)
0x52070000 DMA size 0x1000 — DMA controller with 4 channels
0x52080000 UART1 size 0x1000
0x52081000 UART0 size 0x1000 — UART0 - Universal Asynchronous Receiver/Transmitter
0x52082000 UART2 size 0x1000
0x52083000 I2C0 size 0xD0 — I2C master controller (DesignWare-compatible v151)
0x52084000 I2C1 size 0xD0
0x52087000 SPI0 size 0x100 — SPI0 master/slave controller (SSI v151)
0x52088000 SPI1 size 0x100
0x52089000 SPI2 size 0x100
0x5208D000 KEYSCAN size 0xA0 — Key-scan matrix controller (v150)
0x5208E000 PDM size 0x90 — PDM microphone interface (v150)
0x52090000 PWM size 0x1000 — PWM controller with 8 channels
0x520A0000 SDMA size 0x1000
0x57000000 GLB_CTL_M size 0x200 — Main core global control - BCPU/MCPU reset status, chip reset, AON CRG
0x57000200 TCXO size 0x20 — TCXO 64-bit free-running counter (v150)
0x57008700 ADC_PMU_AFE size 0x40 — ADC PMU AFE power/isolation/reset block
0x57010000 GPIO0 size 0x1000 — GPIO controller for GPIO[7:0]
0x57014000 GPIO1 size 0x1000
0x57018000 GPIO2 size 0x1000
0x5701C000 GPIO3 size 0x1000
0x57020000 GPIO4 size 0x1000
0x57024100 RTC size 0x20 — RTC v150 instance 0 register block
0x5702C000 AON_AFE size 0x240 — AON AFE isolation control used by the BS2X ADC porting layer
0x57030000 ULP_GPIO size 0x1000
0x57036000 GADC size 0x430 — 13-bit GADC (general ADC, v153)
0x58000000 USB size 0x1000 — USB 2.0 OTG controller (Synopsys DWC OTG, device-controller base)

## Interrupts
26 BT_INT0 (GLB_CTL_M) — BT_INT0 (IRQ 26)
27 BT_INT1 (GLB_CTL_M) — BT_INT1 (IRQ 27)
28 GADC_DONE (GADC) — GADC_DONE (IRQ 28)
29 GADC_ALARM (GADC) — GADC_ALARM (IRQ 29)
32 MCU_PCLR_LOCK (GLB_CTL_M) — MCU_PCLR_LOCK (IRQ 32)
33 ULP_GPIO — ULP_GPIO (IRQ 33)
34 GPIO_0 (GPIO0) — GPIO_0 (IRQ 34)
35 GPIO_1 (GPIO1) — GPIO_1 (IRQ 35)
36 BT_TOGGLE_POS (GLB_CTL_M) — BT_TOGGLE_POS (IRQ 36)
37 BT_TOGGLE_NEG (GLB_CTL_M) — BT_TOGGLE_NEG (IRQ 37)
38 KEY_SCAN_LOW_POWER (KEYSCAN) — KEY_SCAN_LOW_POWER (IRQ 38)
39 UART_0 (UART0) — UART_0 (IRQ 39)
40 MCU_SIMO1P1_VSET (GLB_CTL_M) — MCU_SIMO1P1_VSET (IRQ 40)
41 UART_1 (UART1) — UART_1 (IRQ 41)
42 UART_2 (UART2) — UART_2 (IRQ 42)
43 QSPI0_2CS (GLB_CTL_M) — QSPI0_2CS (IRQ 43)
44 PDM — PDM (IRQ 44)
46 KEY_SCAN (KEYSCAN) — KEY_SCAN (IRQ 46)
47 M_WAKEUP (GLB_CTL_M) — M_WAKEUP (IRQ 47)
48 M_SLEEP (GLB_CTL_M) — M_SLEEP (IRQ 48)
49 RTC_0 (RTC) — RTC_0 (IRQ 49)
50 RTC_1 (RTC) — RTC_1 (IRQ 50)
51 RTC_2 (RTC) — RTC_2 (IRQ 51)
52 RTC_3 (RTC) — RTC_3 (IRQ 52)
53 TIMER_0 (TIMER) — TIMER_0 (IRQ 53)
54 TIMER_1 (TIMER) — TIMER_1 (IRQ 54)
55 TIMER_2 (TIMER) — TIMER_2 (IRQ 55)
56 TIMER_3 (TIMER) — TIMER_3 (IRQ 56)
57 M_SDMA (SDMA) — M_SDMA (IRQ 57)
59 SPI_M_S_0 (SPI0) — SPI_M_S_0 (IRQ 59)
60 SPI_M_S_1 (SPI1) — SPI_M_S_1 (IRQ 60)
61 SPI_M (SPI2) — SPI_M (IRQ 61)
62 I2C_0 (I2C0) — I2C_0 (IRQ 62)
63 I2C_1 (I2C1) — I2C_1 (IRQ 63)
64 BT_BB_BT (GLB_CTL_M) — BT_BB_BT (IRQ 64)
65 BT_BB_BLE (GLB_CTL_M) — BT_BB_BLE (IRQ 65)
66 BT_BB_GLE (GLB_CTL_M) — BT_BB_GLE (IRQ 66)
67 I2S (GLB_CTL_M) — I2S (IRQ 67)
68 RF_PRT (GLB_CTL_M) — RF_PRT (IRQ 68)
69 NFC (GLB_CTL_M) — NFC (IRQ 69)
70 SEC (TRNG) — SEC (IRQ 70)
71 PWM_0 (PWM) — PWM_0 (IRQ 71)
72 PWM_1 (PWM) — PWM_1 (IRQ 72)
73 OSC_EN_WKUP (GLB_CTL_M) — OSC_EN_WKUP (IRQ 73)
74 OSC_EN_SLEEP (GLB_CTL_M) — OSC_EN_SLEEP (IRQ 74)
78 PMU_CMU_ERR (GLB_CTL_M) — PMU_CMU_ERR (IRQ 78)
79 ULP_INT (GLB_CTL_M) — ULP_INT (IRQ 79)
85 PMU2_CLK_32K_CALI (GLB_CTL_M) — PMU2_CLK_32K_CALI (IRQ 85)
86 ULP_WKUP_INT (GLB_CTL_M) — ULP_WKUP_INT (IRQ 86)
87 TSENSOR (GLB_CTL_M) — TSENSOR (IRQ 87)
88 QDEC — QDEC (IRQ 88)
89 USB — USB (IRQ 89)

## Licence text in the file
Register definitions derived from public ws63-guide documentation and fbb_ws63 HAL headers. See https://github.com/hispark-rs/ws63-guide and https://github.com/hispark-rs/ws63-svd
